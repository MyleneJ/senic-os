## meta-senic/conf/distro/senic.conf
```bitbake
DISTRO_NAME = "senic"
DISTRO_VERSION  = "1.0"

IMAGE_LINGUAS = "en-us"

DISTRO_FEATURES = "${DISTRO_FEATURES_DEFAULT} ${DISTRO_FEATURES_LIBC} usb bluetooth wifi"
DISTRO_TYPE ?= "release"

# Enable systemd for Mender.io
DISTRO_FEATURES_append = " systemd"
VIRTUAL-RUNTIME_init_manager = "systemd"
DISTRO_FEATURES_BACKFILL_CONSIDERED = "sysvinit"
VIRTUAL-RUNTIME_initscripts = ""

INHERIT += "mender-full"
```
